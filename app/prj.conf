## CMakeLists.txt
```
cmake_minimum_required(VERSION 3.20.0)
find_package(Zephyr REQUIRED HINTS $ENV{ZEPHYR_BASE})
project(bms_blinky)

target_sources(app PRIVATE src/main.c)
```

## prj.conf
```kconfig
# 最小点灯应用配置(尽量精简以适配 64KB 内部 Flash)
CONFIG_GPIO=y
CONFIG_PRINTK=y

# 日志子系统:双后端(UART 串口 + SEGGER RTT),供调试器与串口同时看日志
CONFIG_LOG=y
CONFIG_USE_SEGGER_RTT=y
CONFIG_LOG_BACKEND_RTT=y
CONFIG_LOG_BACKEND_UART=y
```

## prj_debug.conf
```kconfig
# Debug 覆盖层(骨架)
# 用法:west build ... -- -DEXTRA_CONF_FILE=prj_debug.conf
# 叠加在 app/prj.conf 之上,面向开发/调试:最大化可观测性。

# 详细日志(即时模式,便于崩溃现场保留)
CONFIG_LOG=y
CONFIG_LOG_MODE_IMMEDIATE=y
CONFIG_LOG_DEFAULT_LEVEL=4

# 断言与线程名(便于定位)
CONFIG_ASSERT=y
CONFIG_THREAD_NAME=y

# 栈/线程分析(按需取消注释)
# CONFIG_THREAD_ANALYZER=y
```

## prj_release.conf
```kconfig
# Release 加固覆盖层(骨架)
# 用法:west build ... -- -DEXTRA_CONF_FILE=prj_release.conf
# 叠加在 app/prj.conf 之上,面向量产/功能安全运行态:关调试设施、收紧运行时行为。
# 下列为方向示例,具体取舍随安全策略与板级补充。

# 关闭调试日志与 RTT(量产可关,减小体量、避免信息泄露)
CONFIG_LOG=n
CONFIG_USE_SEGGER_RTT=n

# 体量优先优化
CONFIG_SIZE_OPTIMIZATIONS=y

# 看门狗:量产建议启用(驱动/超时按板级补充后取消注释)
# CONFIG_WATCHDOG=y
```

## src/main.c
```c
/*
 * BMS 最小点灯示例:验证工程能编译、烧录并在 ART-Pi2 上运行。
 */
#include <zephyr/kernel.h>
#include <zephyr/drivers/gpio.h>
#include <zephyr/logging/log.h>

/* 日志模块:输出经 log 子系统分发到 UART 与 RTT 两个 backend(见 prj.conf) */
LOG_MODULE_REGISTER(bms_blinky, LOG_LEVEL_INF);

/* 板级 devicetree 里 led0 = &red_led */
#define LED0_NODE DT_ALIAS(led0)
static const struct gpio_dt_spec led = GPIO_DT_SPEC_GET(LED0_NODE, gpios);

int main(void)
{
	if (!gpio_is_ready_dt(&led)) {
		LOG_ERR("LED device not ready");
		return 0;
	}

	if (gpio_pin_configure_dt(&led, GPIO_OUTPUT_ACTIVE) < 0) {
		LOG_ERR("Failed to configure LED");
		return 0;
	}

	LOG_INF("BMS blinky start on ART-Pi2");

	uint32_t tick = 0;

	while (1) {
		gpio_pin_toggle_dt(&led);
		LOG_INF("blink #%u", tick++);
		k_msleep(3000);
	}

	return 0;
}
```
